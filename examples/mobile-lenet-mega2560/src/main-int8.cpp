// Case Study 2: Mobile-LeNet-16 full INT8; PROGMEM weights + SD feature maps,
// with B6 (layers 12 and 13) in SRAM to match the FP32 benchmark placement.
// Uses existing Noodle INT8 tensor/file APIs.
// Input: 256 raw uint8 bytes, same sender_uno_fcn16.py as Case 1.
// Firmware requires include/case2_int8_quant.h generated by Colab notebook.
#include <Arduino.h>
#include <avr/io.h>
#include <avr/pgmspace.h>
#include <stdint.h>
#include <math.h>
#include "noodle.h"
#include "noodle_int8.h"
#include "int8/case2_int8_quant.h"
#include "int8/model_progmem.h"

#ifndef NOODLE_USE_INT8
#error Build with -D NOODLE_USE_INT8
#endif
#ifndef NOODLE_SD_CS
#define NOODLE_SD_CS 53
#endif
#ifndef CASE2_B6_RAM
#define CASE2_B6_RAM 1
#endif

static constexpr uint32_t BAUD = 115200;
static constexpr uint16_t N_PIXELS = 256;
static constexpr uint32_t RX_TIMEOUT_MS = 3000;
static uint8_t rx_pixels[N_PIXELS];
static int8_t q_pixels[N_PIXELS];
static uint32_t stages_us[14];

extern char __heap_start;
extern void *__brkval;
static int free_ram() {
  char stack_top;
  return (int)(&stack_top - (__brkval ? (char *)__brkval : &__heap_start));
}

// Never send repeated READY lines while idle.
// Return 0=idle, 1=full image, -1=partial image.
static int receive_bytes(uint8_t *p, uint16_t n) {
  if (!Serial.available()) return 0;
  const uint32_t start = millis();
  uint16_t pos = 0;
  while (pos < n && (uint32_t)(millis() - start) < RX_TIMEOUT_MS) {
    if (Serial.available()) p[pos++] = (uint8_t)Serial.read();
  }
  return pos == n ? 1 : -1;
}

static void filename(char *dst, char prefix, uint8_t layer) {
  // Maximum 8.3 FAT filename, no String allocations. E.g. W01.BIN.
  dst[0] = prefix;
  dst[1] = (char)('0' + layer / 10);
  dst[2] = (char)('0' + layer % 10);
  dst[3] = '.'; dst[4] = 'B'; dst[5] = 'I'; dst[6] = 'N'; dst[7] = 0;
}

// Check one SD file and immediately close it, before the kernel opens
// up to 6 simultaneous files. No heap allocations or retained file handles.
static bool check_param(char prefix, uint8_t layer, uint32_t expected) {
  char path[8];
  filename(path, prefix, layer);
  NDL_File f = noodle_fs_open_read(path);
  if (!f) {
    Serial.print(F("DIAG FILE_MISSING ")); Serial.println(path);
    return false;
  }
  const uint32_t actual = f.size();
  f.close();
  if (actual != expected) {
    Serial.print(F("DIAG FILE_SIZE ")); Serial.print(path);
    Serial.print(F(" expected=")); Serial.print(expected);
    Serial.print(F(" actual=")); Serial.println(actual);
    return false;
  }
  return true;
}

static bool check_layer_params(uint8_t layer, uint16_t inC) {
  const uint32_t outC = CASE2_OUT_CHANNELS[layer-1];
  const uint32_t K = CASE2_K[layer-1];
  const uint32_t wbytes = outC * K * K *
      (CASE2_IS_DEPTHWISE[layer-1] ? 1UL : (uint32_t)inC);
  const uint32_t ibytes = outC * 4UL;
  return check_param('W',layer,wbytes) &&
         check_param('B',layer,ibytes) &&
         check_param('M',layer,ibytes) &&
         check_param('S',layer,ibytes);
}

static void trace_start(uint8_t layer, const NoodleTensor *src) {
  Serial.print(F("DIAG BEGIN layer=")); Serial.print(layer);
  Serial.print(F(" C="));Serial.print(src->C);
  Serial.print(F(" W="));Serial.print(src->W);
  Serial.print(F(" free_ram=")); Serial.println(free_ram());
}

static void trace_end(uint8_t layer, uint16_t result,
                      const NoodleTensor *dst, uint32_t elapsed) {
  Serial.print(F("DIAG END layer=")); Serial.print(layer);
  Serial.print(F(" result=")); Serial.print(result);
  Serial.print(F(" C=")); Serial.print(dst->C);
  Serial.print(F(" W=")); Serial.print(dst->W);
  Serial.print(F(" us=")); Serial.print(elapsed);
  Serial.print(F(" free_ram=")); Serial.println(free_ram());
}

static uint16_t run_weighted(uint8_t index, NoodleTensor *in, NoodleTensor *out) {
  ConvProgmem c;
  // Exported INT8 W/B/M/S arrays are in flash, not SRAM or SD.
#define CASE2_BIND_LAYER(i, nn) \
  case i: c.weight = noodle_w##nn##_flash; \
          c.bias = noodle_bias##nn##_flash; \
          c.multiplier = noodle_mult##nn##_flash; \
          c.shift = noodle_shift##nn##_flash; break
  switch (index) {
    CASE2_BIND_LAYER(1, 01); CASE2_BIND_LAYER(2, 02);
    CASE2_BIND_LAYER(3, 03); CASE2_BIND_LAYER(4, 04);
    CASE2_BIND_LAYER(5, 05); CASE2_BIND_LAYER(6, 06);
    CASE2_BIND_LAYER(7, 07); CASE2_BIND_LAYER(8, 08);
    CASE2_BIND_LAYER(9, 09); CASE2_BIND_LAYER(10, 10);
    CASE2_BIND_LAYER(11, 11); CASE2_BIND_LAYER(12, 12);
    CASE2_BIND_LAYER(13, 13);
    default: return 0;
  }
#undef CASE2_BIND_LAYER
  c.O = CASE2_OUT_CHANNELS[index-1];
  c.K = CASE2_K[index-1]; c.P = CASE2_PADDING[index-1];
  c.S = CASE2_STRIDE[index-1];
  c.input_scale = CASE2_INPUT_SCALES[index-1];
  c.output_scale = CASE2_OUTPUT_SCALES[index-1];
  c.input_zero_point = CASE2_INPUT_ZPS[index-1];
  c.output_zero_point = CASE2_OUTPUT_ZPS[index-1];
  c.depth_multiplier = 1;
  c.act = ACT_RELU;
  c.activation_min = noodle_activation_min_relu(c.output_scale, c.output_zero_point);
  c.activation_max = 127;
  NoodleI8Pool identity;
  identity.M = 1; identity.T = 1;
  return CASE2_IS_DEPTHWISE[index-1]
      ? noodle_i8_dwconv2d_fused(in, c, identity, out)
      : noodle_i8_conv2d_fused(in, c, identity, out);
}

static void predict() {
  const uint32_t t0 = micros();
  // Transmitted pixels are PIL-resized grayscale bytes, normalized as uint8/255.
  for (uint16_t i=0; i<N_PIXELS; ++i) {
    const float real = rx_pixels[i] * (1.0f/255.0f);
    q_pixels[i] = (int8_t)noodle_quantize_float(real, CASE2_INPUT_SCALE, CASE2_INPUT_ZP);
  }

  NoodleTensor a, b, tail, pooled, logits;
#if CASE2_B6_RAM
  NoodleTensor tail_scratch;
  noodle_tensor_init(&tail_scratch);
#endif
  noodle_tensor_init(&a); noodle_tensor_init(&b);
  noodle_tensor_init(&tail); noodle_tensor_init(&pooled); noodle_tensor_init(&logits);
  uint8_t fail = 0;
  if (!noodle_i8_tensor_bind_file(&a, "XA.BIN") ||
      !noodle_i8_tensor_bind_file(&b, "XB.BIN") ||
      !noodle_i8_tensor_file_2d(&a, 1, 16, CASE2_INPUT_SCALE, CASE2_INPUT_ZP) ||
      !noodle_i8_tensor_write_file(&a, q_pixels, N_PIXELS)) {
    fail = 1; goto cleanup;
  }
  {
    NoodleTensor *src = &a, *dst = &b;
    // For the parity experiment, first 11 layers remain SD+PROGMEM.
    // The reference setting (CASE2_B6_RAM=0) runs all 13 layers on SD.
    for (uint8_t layer=1; layer<=(CASE2_B6_RAM ? 11 : 13); ++layer) {
      trace_start(layer, src);
      // Flash parameters matched with exported SD binaries before packaging.
      const uint32_t st = micros();
      const uint16_t result = run_weighted(layer, src, dst);
      stages_us[layer-1] = micros()-st;
      trace_end(layer, result, dst, stages_us[layer-1]);
      if (!result || dst->C != CASE2_OUT_CHANNELS[layer-1] ||
          dst->W != CASE2_OUT_WIDTHS[layer-1]) {
        Serial.print(F("DIAG KERNEL_OR_SHAPE_FAIL layer="));Serial.println(layer);
        fail = layer + 1; break;
      }
      NoodleTensor *swap = src; src = dst; dst = swap;
    }
    if (fail) goto cleanup;
    if (src->C != 24 || src->W != 4) { fail = 16; goto cleanup; }
    // The map after B5 PW (layer 11) is 24x4x4 = 384 INT8 bytes.
    // In CASE2_B6_RAM=1 mode this copy occurs BEFORE B6, just like FP32.
    // In control mode (0), it occurs AFTER layer 13 for GAP only.
    int8_t *tail_data = noodle_i8_tensor_require_2d(
        &tail, 24, 4, src->scale, src->zero_point);
    if (!tail_data || !noodle_i8_tensor_read_file(src, tail_data, 384)) {
      fail = 17; goto cleanup;
    }
#if CASE2_B6_RAM
    Serial.println(F("DIAG B6_INPUT_COPY SD_TO_SRAM bytes=384"));
    for (uint8_t layer = 12; layer <= 13; ++layer) {
      NoodleTensor *ram_src = layer == 12 ? &tail : &tail_scratch;
      NoodleTensor *ram_dst = layer == 12 ? &tail_scratch : &tail;
      trace_start(layer, ram_src);
      const uint32_t st = micros();
      const uint16_t result = run_weighted(layer, ram_src, ram_dst);
      stages_us[layer - 1] = micros() - st;
      trace_end(layer, result, ram_dst, stages_us[layer - 1]);
      if (!result || ram_dst->C != CASE2_OUT_CHANNELS[layer-1] ||
          ram_dst->W != CASE2_OUT_WIDTHS[layer-1]) {
        Serial.print(F("DIAG KERNEL_OR_SHAPE_FAIL layer=")); Serial.println(layer);
        fail = layer + 1; break;
      }
    }
    if (fail) goto cleanup;
#endif
  }
  {
    // TFLite MEAN has its own output quantization; do not assume it equals B6.
    NoodleI8Requant rq;
    rq.output_scale = CASE2_GAP_OUTPUT_SCALE;
    rq.output_zero_point = CASE2_GAP_OUTPUT_ZP;
    if (!noodle_quantize_multiplier(
           (double)tail.scale / (16.0 * (double)rq.output_scale),
           &rq.multiplier, &rq.shift)) { fail = 18; goto cleanup; }
    if (noodle_i8_gap(&tail,rq,&pooled) != 24) { fail = 19; goto cleanup; }
  }
  {
    trace_start(14, &pooled);
    FCNProgmem fc;
    fc.weight_far = NOODLE_PGM_ADDRESS(noodle_w14_flash);
    fc.bias_far = NOODLE_PGM_ADDRESS(noodle_bias14_flash);
    fc.multiplier_far = NOODLE_PGM_ADDRESS(noodle_mult14_flash);
    fc.shift_far = NOODLE_PGM_ADDRESS(noodle_shift14_flash);
    fc.O = 10; fc.act = ACT_NONE;
    fc.input_scale = CASE2_INPUT_SCALES[13];
    fc.output_scale = CASE2_OUTPUT_SCALES[13];
    fc.input_zero_point = CASE2_INPUT_ZPS[13];
    fc.output_zero_point = CASE2_OUTPUT_ZPS[13];
    fc.activation_min = -128; fc.activation_max = 127;
    const uint32_t st = micros();
    const uint16_t result = noodle_i8_fcn(&pooled, fc, &logits);
    stages_us[13] = micros()-st;
    trace_end(14,result,&logits,stages_us[13]);
    if (result != 10) { fail = 20; goto cleanup; }
  }
  {
    uint8_t best = 0;
    const int8_t *q = noodle_tensor_const_data(&logits);
    for (uint8_t i=1; i<10; ++i) if (q[i] > q[best]) best = i;
    // Softmax confidence is calculated from logits solely for sender compatibility.
    float denominator=0.0f;
    for(uint8_t i=0;i<10;++i)
      denominator += expf(((int16_t)q[i] - q[best]) * logits.scale);
    const float confidence = denominator > 0.0f ? 1.0f/denominator : 0.0f;
    const uint32_t elapsed = micros() - t0;
    Serial.print(F("PRED ")); Serial.print(best); Serial.print(' ');
    Serial.print(elapsed*1e-6f, 4); Serial.print(' '); Serial.println(confidence,6);
    Serial.print(F("LOGITS"));
    for(uint8_t i=0;i<10;++i) { Serial.print(' '); Serial.print((int)q[i]); }
    Serial.println();
    Serial.print(F("MEM tail_bytes=384 free_ram="));Serial.println(free_ram());
    for (uint8_t i=0;i<14;++i) {
      Serial.print(F("STAGE ")); Serial.print(i+1);
      Serial.print(' '); Serial.println(stages_us[i]);
    }
  }
cleanup:
  noodle_tensor_free(&a); noodle_tensor_free(&b);
  noodle_tensor_free(&tail); noodle_tensor_free(&pooled); noodle_tensor_free(&logits);
#if CASE2_B6_RAM
  noodle_tensor_free(&tail_scratch);
#endif
  if (fail) { Serial.print(F("ERR CASE2_STAGE_")); Serial.println(fail); }
  Serial.print(F("DIAG PREDICT_END free_ram=")); Serial.println(free_ram());
}

void setup() {
  Serial.begin(BAUD); delay(200);
  pinMode(53, OUTPUT); digitalWrite(53,HIGH);
  if(!noodle_fs_init(NOODLE_SD_CS)) {
    Serial.println(F("ERR SD_INIT")); while(true) delay(500);
  }
  Serial.println(F("DIAG PARAM_BACKEND=PROGMEM ACT_BACKEND=SD"));
#if CASE2_B6_RAM
  Serial.println(F("DIAG B6_BACKEND=SRAM"));
#else
  Serial.println(F("DIAG B6_BACKEND=SD"));
#endif
  Serial.print(F("DIAG BOOT free_ram="));Serial.println(free_ram());
  Serial.println(F("READY"));
}
void loop() {
  const int rx = receive_bytes(rx_pixels, N_PIXELS);
  if (rx == 0) return; // Silent when idle: no duplicate READY.
  if (rx < 0) {
    Serial.println(F("ERR RX_PARTIAL"));
    Serial.println(F("READY")); return;
  }
  predict();
  Serial.println(F("READY"));
}
