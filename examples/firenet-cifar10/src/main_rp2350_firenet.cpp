#include <Arduino.h>

#ifndef NOODLE_USE_NONE
#define NOODLE_USE_NONE
#endif
#ifndef NOODLE_POOL_MODE
#define NOODLE_POOL_MODE NOODLE_POOL_MAX
#endif

#include "noodle.h"
#include "noodle_serial.h"
#include "model_weights.h"

// ============================================================
// RP2350 / Pico Tiny FireNet CIFAR-10 serial demo
// ============================================================
//
// Input protocol:
//   Host sends "IMG"
//   Device replies "RDYIMG"
//   Host sends 32*32*3 RGd bytes in chunks
//   Device replies "ACK" after each chunk
//   Device runs Tiny FireNet
//   Device prints:
//       PRED <class_id> <seconds> <confidence> <class_name>
//   Device prints READY
//
// Input image layout from host:
//   HWC RGB uint8: [y][x][r,g,b], 3072 bytes
//
// Noodle tensor layout:
//   CHW float: [c][y][x], normalized to [0, 1]
//
// Model:
//
//   Input RGB              3 x 32 x 32
//   Stem Conv3x3           24 x 32 x 32
//   MaxPool                24 x 16 x 16
//
//   Fire1 squeeze1x1       12 x 16 x 16
//   Fire1 expand1x1        24 x 16 x 16
//   Fire1 expand3x3        24 x 16 x 16
//   Fire1 concat           48 x 16 x 16
//
//   Fire2 squeeze1x1       24 x 16 x 16
//   Fire2 expand1x1        32 x 16 x 16
//   Fire2 expand3x3        32 x 16 x 16
//   Fire2 concat           64 x 16 x 16
//   MaxPool                64 x 8 x 8
//
//   Fire3 squeeze1x1       32 x 8 x 8
//   Fire3 expand1x1        48 x 8 x 8
//   Fire3 expand3x3        48 x 8 x 8
//   Fire3 concat           96 x 8 x 8
//
//   GAP                    96
//   Dense + softmax        10
//
// Required Noodle compile flags:
//   -DNOODLE_USE_NONE
//   -DNOODLE_POOL_MODE=NOODLE_POOL_MAX
//
// The model_weights.h file is generated by the Colab notebook.
// ============================================================

static const uint16_t IMG_W = 32;
static const uint16_t IMG_H = 32;
static const uint16_t IMG_C = 3;
static const uint16_t IMG_PIXELS = IMG_W * IMG_H;
static const uint16_t IMG_BYTES = IMG_PIXELS * IMG_C;

static uint8_t RX_BYTES[IMG_BYTES];

// Main tensor buffers.
static NoodleBuffer X;   // input or general tensor
static NoodleBuffer A;   // general tensor
static NoodleBuffer B;   // general tensor

// Fire-module scratch buffers.
// S must remain alive while expand1 and expand3 are computed.
// E1 and E3 must remain alive until noodle_concat() finishes.
static NoodleBuffer S;
static NoodleBuffer E1;
static NoodleBuffer E3;

static const char *CLASS_NAMES[10] = {
  "airplane", "automobile", "bird", "cat", "deer",
  "dog", "frog", "horse", "ship", "truck"
};

// ============================================================
// Small helpers
// ============================================================

static void make_conv(ConvMem &c,
                      uint16_t K,
                      uint16_t P,
                      uint16_t S_stride,
                      const float *w,
                      const float *b,
                      Activation act) {
  c.K = K;
  c.P = P;
  c.S = S_stride;
  c.OP = 0;
  c.weight = w;
  c.bias = b;
  c.act = act;
}

static void make_fcn(FCNMem &f,
                     const float *w,
                     const float *b,
                     Activation act) {
  f.weight = w;
  f.bias = b;
  f.act = act;
}

static Pool no_pool() {
  Pool p;
  p.M = 1;
  p.T = 1;
  return p;
}

static bool hwc_rgb_u8_to_chw_float(const uint8_t *src, NoodleBuffer *dst) {
  float *x = noodle_buffer_require(dst, IMG_PIXELS * IMG_C);
  if (!x) return false;

  for (uint16_t y = 0; y < IMG_H; ++y) {
    for (uint16_t xpix = 0; xpix < IMG_W; ++xpix) {
      const uint32_t hwc = ((uint32_t)y * IMG_W + xpix) * 3;
      const uint32_t chw0 = (uint32_t)y * IMG_W + xpix;
      x[0 * IMG_PIXELS + chw0] = (float)src[hwc + 0] * (1.0f / 255.0f);
      x[1 * IMG_PIXELS + chw0] = (float)src[hwc + 1] * (1.0f / 255.0f);
      x[2 * IMG_PIXELS + chw0] = (float)src[hwc + 2] * (1.0f / 255.0f);
    }
  }

  return true;
}

static uint16_t maxpool2d_chw(NoodleBuffer *input,
                              uint16_t C,
                              uint16_t W,
                              NoodleBuffer *output,
                              uint16_t M = 2,
                              uint16_t T = 2) {
  if (!input || !output || !input->data) return 0;
  if (W < M || T == 0) return 0;

  const uint16_t Wo = (uint16_t)((W - M) / T + 1);
  const uint32_t in_plane = (uint32_t)W * W;
  const uint32_t out_plane = (uint32_t)Wo * Wo;

  float *y = noodle_buffer_require(output, (size_t)C * out_plane);
  if (!y) return 0;

  const float *x = input->data;

  for (uint16_t c = 0; c < C; ++c) {
    const float *xc = x + (uint32_t)c * in_plane;
    float *yc = y + (uint32_t)c * out_plane;

    for (uint16_t oy = 0; oy < Wo; ++oy) {
      for (uint16_t ox = 0; ox < Wo; ++ox) {
        float m = xc[(uint32_t)(oy * T) * W + (ox * T)];

        for (uint16_t ky = 0; ky < M; ++ky) {
          for (uint16_t kx = 0; kx < M; ++kx) {
            const uint16_t iy = oy * T + ky;
            const uint16_t ix = ox * T + kx;
            const float v = xc[(uint32_t)iy * W + ix];
            if (v > m) m = v;
          }
        }

        yc[(uint32_t)oy * Wo + ox] = m;
      }
    }
  }

  return Wo;
}

static uint16_t run_fire(NoodleBuffer *input,
                         uint16_t C_in,
                         uint16_t W,
                         NoodleBuffer *output,
                         const ConvMem &squeeze,
                         uint16_t C_sq,
                         const ConvMem &expand1,
                         uint16_t C_e1,
                         const ConvMem &expand3,
                         uint16_t C_e3) {
  const Pool p = no_pool();

  uint16_t V = noodle_conv_float(input, C_in, C_sq, &S, W, squeeze, p, NULL);
  if (V != W) {
    Serial.print(F("ERR fire squeeze W="));
    Serial.println(V);
    return 0;
  }

  V = noodle_conv_float(&S, C_sq, C_e1, &E1, W, expand1, p, NULL);
  if (V != W) {
    Serial.print(F("ERR fire expand1 W="));
    Serial.println(V);
    return 0;
  }

  V = noodle_conv_float(&S, C_sq, C_e3, &E3, W, expand3, p, NULL);
  if (V != W) {
    Serial.print(F("ERR fire expand3 W="));
    Serial.println(V);
    return 0;
  }

  const uint16_t C_out = noodle_concat(&E1, C_e1, &E3, C_e3, output, W);
  if (C_out != (uint16_t)(C_e1 + C_e3)) {
    Serial.println(F("ERR fire concat"));
    return 0;
  }

  return C_out;
}

// ============================================================
// Prediction
// ============================================================

static bool predict() {
  const Pool p = no_pool();

  ConvMem stem;
  make_conv(stem, 3, 65535, 1, w01, b01, ACT_RELU);

  ConvMem f1s, f1e1, f1e3;
  make_conv(f1s,  1, 0,     1, w02, b02, ACT_RELU);
  make_conv(f1e1, 1, 0,     1, w03, b03, ACT_RELU);
  make_conv(f1e3, 3, 65535, 1, w04, b04, ACT_RELU);

  ConvMem f2s, f2e1, f2e3;
  make_conv(f2s,  1, 0,     1, w05, b05, ACT_RELU);
  make_conv(f2e1, 1, 0,     1, w06, b06, ACT_RELU);
  make_conv(f2e3, 3, 65535, 1, w07, b07, ACT_RELU);

  ConvMem f3s, f3e1, f3e3;
  make_conv(f3s,  1, 0,     1, w08, b08, ACT_RELU);
  make_conv(f3e1, 1, 0,     1, w09, b09, ACT_RELU);
  make_conv(f3e3, 3, 65535, 1, w10, b10, ACT_RELU);

  FCNMem classifier;
  make_fcn(classifier, w11, b11, ACT_SOFTMAX);

  uint16_t W = IMG_W;
  uint16_t C = IMG_C;

  const uint32_t t_all = micros();

  // Stem: X -> A, 3x32x32 -> 24x32x32
  W = noodle_conv_float(&X, C, 24, &A, W, stem, p, NULL);
  if (W != 32) {
    Serial.print(F("ERR stem W="));
    Serial.println(W);
    return false;
  }
  C = 24;

  // Pool1: A -> B, 24x32x32 -> 24x16x16
  //W = maxpool2d_chw(&A, C, W, &B, 2, 2);
  W = noodle_pool2d(&A, C, W, &B, 2, 2);
  if (W != 16) {
    Serial.print(F("ERR pool1 W="));
    Serial.println(W);
    return false;
  }

  // Fire1: B -> A, 24x16x16 -> 48x16x16
  C = run_fire(&B, C, W, &A, f1s, 12, f1e1, 24, f1e3, 24);
  if (C != 48) return false;

  // Fire2: A -> B, 48x16x16 -> 64x16x16
  C = run_fire(&A, C, W, &B, f2s, 24, f2e1, 32, f2e3, 32);
  if (C != 64) return false;

  // Pool2: B -> A, 64x16x16 -> 64x8x8
  W = noodle_pool2d(&B, C, W, &A, 2, 2);
  if (W != 8) {
    Serial.print(F("ERR pool2 W="));
    Serial.println(W);
    return false;
  }

  // Fire3: A -> B, 64x8x8 -> 96x8x8
  C = run_fire(&A, C, W, &B, f3s, 32, f3e1, 48, f3e3, 48);
  if (C != 96) return false;

  // GAP in-place on B: 96x8x8 -> 96
  uint16_t V = noodle_gap(&B, C, W);
  if (V != C) {
    Serial.print(F("ERR gap V="));
    Serial.println(V);
    return false;
  }

  // Dense classifier: B[96] -> A[10], includes softmax.
  V = noodle_fcn(&B, V, 10, &A, classifier, NULL);
  if (V != 10) {
    Serial.print(F("ERR classifier V="));
    Serial.println(V);
    return false;
  }

  uint16_t pred = 0;
  float max_val = 0.0f;
  noodle_find_max(&A, 10, max_val, pred);

  const float et = (float)(micros() - t_all) * 1e-6f;
  char pred_line[96];
  snprintf(pred_line, sizeof(pred_line),
          "PRED %u %.6f %.6f %s",
          pred,
          et,
          max_val,
          CLASS_NAMES[pred]);

  Serial.println(pred_line);
  Serial.flush();

  return true;
}

// ============================================================
// Arduino setup / loop
// ============================================================

void setup() {
  NoodleSerial::begin(921600);
  NoodleSerial::clear_input();

  noodle_buffer_init(&X);
  noodle_buffer_init(&A);
  noodle_buffer_init(&B);
  noodle_buffer_init(&S);
  noodle_buffer_init(&E1);
  noodle_buffer_init(&E3);

  Serial.println(F("BOOT RP2350 Tiny FireNet CIFAR-10"));
  Serial.println(F("Input: RGB 32x32x3 HWC uint8"));
  Serial.println(F("Runtime: NoodleBuffer + Fire concat"));
  NoodleSerial::print_ready();
}

void loop() {
  if (!NoodleSerial::wait_for_img_header()) {
    NoodleSerial::print_ready();
    return;
  }

  if (!NoodleSerial::recv_image_chunked(RX_BYTES, IMG_BYTES)) {
    NoodleSerial::print_ready();
    return;
  }

  if (!hwc_rgb_u8_to_chw_float(RX_BYTES, &X)) {
    Serial.println(F("ERR input alloc"));
    NoodleSerial::print_ready();
    return;
  }

  predict();

  NoodleSerial::print_ready();
}
